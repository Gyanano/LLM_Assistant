## main/Kconfig.projbuild
```kconfig
menu "LLM_Assistant Configuration"

    # The WiFi configuration
    config ESP_WIFI_SSID
        string "WiFi SSID"
        default "myssid"
        help
            SSID (network name) for the example to connect to.

    config ESP_WIFI_PASSWORD
        string "WiFi Password"
        default "mypassword"
        help
            WiFi password (WPA or WPA2) for the example to use.

    # The audio configuration
    config VOICE_VOLUME
        int "Voice volume"
        range 0 100
        default 50
        help
            Set voice volume

    # The baidu API auth configuration
    config BAIDU_ACCESS_KEY
        string "Baidu Access Key"
        default "myaccesskey"
        help
            Baidu Access Key for the example to use.

    config BAIDU_SECRET_KEY
        string "Baidu Secret Key"
        default "mysecretkey"
        help
            Baidu Secret Key for the example to use.

    # The minimax API auth configuration
    
    
endmenu
```
